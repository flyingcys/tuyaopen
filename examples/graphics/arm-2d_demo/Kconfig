## src/graphics/Kconfig
```kconfig
menu "configure graphics"
    rsource "arm-2d/Kconfig"
    rsource "lvgl/Kconfig"
endmenu
```

## src/graphics/arm-2d/Kconfig
```kconfig
menuconfig ENABLE_ARM2D
    bool "Enable arm-2d"
    default n

    if ENABLE_ARM2D
        
    endif
```
