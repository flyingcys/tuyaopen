## boards/ESP32/bread-compact-wifi/Kconfig
```kconfig
config CHIP_CHOICE
    string
    default "esp32s3"

config BOARD_CHOICE
    string
    default "bread-compact-wifi"

config BOARD_CONFIG
    bool
    default y
    select ENABLE_AUDIO
    select ENABLE_DISPLAY
    select PLATFORM_FLASHSIZE_16M

config AUDIO_DRIVER_NAME
    string "the name of the audio driver"
    default "audio_driver"

choice
    prompt "OLED choice"
    default OLED_128x32

    config OLED_128x32
        bool "OLED 128x32"
        help
            OLED 128x32

    config OLED_128x64
        bool "OLED 128x64"
        help
            OLED 128x64
endchoice
```

## examples/wifi/sta/Kconfig
```kconfig
menu "Application config"

    config EXAMPLE_SSID
        string "connect ssid"
        default 1 if (PLATFORM_T3)
        range 1 64

    config EXAMPLE_PASSWORD
        string "connect password"
        range 8 32

endmenu
```

## src/device_driver/display/Kconfig
```kconfig
config ENABLE_DISPLAY_DRIVER
    bool "enable display driver"
    default n

if (ENABLE_DISPLAY_DRIVER)
    config ENABLE_DISPLAY_SPI
        bool "enable spi tft-lcd driver"
        depends on ENABLE_SPI
        default y

    if (ENABLE_DISPLAY_SPI)
        choice 
            prompt "configure tft lcd driver type"
            default ENABLE_DISPLAY_SPI_ST7789

            config ENABLE_DISPLAY_SPI_ST7789
                bool "st7789"

            config ENABLE_DISPLAY_SPI_GC9A01
                bool "gc9a01"

            config ENABLE_DISPLAY_SPI_ILI9341
                bool "ili9341"
        endchoice

        menu "configure tft lcd driver"
            config DISPLAY_SPI_PORT
                int "tft lcd spi port"
                range 0 5
                default 0

            config DISPLAY_SPI_CLK
                int "tft lcd spi spi freq"
                default 48000000
                
            config DISPLAY_SPI_CS_PIN
                int "tft lcd cs pin"
                range 0 64
                default 40

            config DISPLAY_SPI_DC_PIN
                int "tft lcd dc pin"
                range 0 64
                default 15

            config DISPLAY_SPI_RST_PIN
                int "tft lcd rst pin"
                range 0 64
                default 17

            config DISPLAY_SPI_BL_PIN
                int "tft lcd bl pin"
                range 0 64
                default 32
            
            config DISPLAY_SPI_BL_PIN_POLARITY_HIGH
                bool "tft lcd backlight high active "
                default y
            
            config DISPLAY_SPI_BL_PWM
                bool "enable tft lcd backlight pwm"
                default y

            if (DISPLAY_SPI_BL_PWM)
                config DISPLAY_SPI_BL_PWM_ID
                    int "tft lcd backlight pwm id"
                    range 0 4
                    default 0

                config DISPLAY_SPI_BL_PWM_FREQ
                    int "tft lcd backlight pwm freq"
                    range 1000 100000
                    default 10000
            endif
        endmenu

    endif

endif
```

## src/liblvgl/Kconfig
```kconfig
config ENABLE_LIBLVGL
    bool "configure lvgl"
    select ENABLE_DISPLAY_DRIVER
    default y

if (ENABLE_LIBLVGL)
    config ENABLE_LVGL_DEMO
        bool "enable lvgl demo"
        default n

    config LV_DISP_HOR_RES
        int "screen width"
        default 240

    config LV_DISP_VER_RES
        int "screen height"
        default 240

    config LVGL_ENABLE_TOUCH
        bool "enable lvgl touch"
        select ENABLE_TOUCH_DRIVER
        default n

    config LVGL_ENABLE_ENCODER
        bool "enable lvgl encoder"
        select ENABLE_ENCODER_DRIVER
        default n

    config LVGL_COLOR_DEPTH
        int "color depth"
        range 16 32
        default 16

    config LVGL_COLOR_16_SWAP
        bool "swap color bytes"
        default y

endif
```
